## main/Kconfig.projbuild
```kconfig
menu "Camera Uploader"

    config APP_WIFI_SSID
        string "WiFi SSID"
        default "YOUR_WIFI_SSID"
        help
            SSID of the WiFi network to join.

    config APP_WIFI_PASSWORD
        string "WiFi Password"
        default "YOUR_WIFI_PASSWORD"
        help
            Password for the WiFi network.

    config APP_UPLOAD_URL
        string "Photo upload URL"
        default "https://example.com/upload"
        help
            HTTP(S) endpoint that accepts multipart/form-data with an image field.

    config APP_UPLOAD_FIELD_NAME
        string "Multipart form field name"
        default "image"
        help
            Name of the form field used for the JPEG payload.

    config APP_CAPTURE_INTERVAL_MS
        int "Capture interval (milliseconds)"
        default 20000
        range 1000 3600000
        help
            Delay between capture and upload attempts.

    choice APP_CAMERA_WB_MODE
        prompt "Camera white balance preset"
        default APP_CAMERA_WB_MODE_OFFICE
        help
            OV2640/OV3660 white balance preset. Use Office or Home for indoor scenes;
            Auto can leave a warm/yellow cast under mixed indoor lighting.

        config APP_CAMERA_WB_MODE_AUTO
            bool "Auto"
        config APP_CAMERA_WB_MODE_SUNNY
            bool "Sunny"
        config APP_CAMERA_WB_MODE_CLOUDY
            bool "Cloudy"
        config APP_CAMERA_WB_MODE_OFFICE
            bool "Office"
        config APP_CAMERA_WB_MODE_HOME
            bool "Home"
    endchoice

    config APP_CAMERA_WB_MODE_VALUE
        int
        default 0 if APP_CAMERA_WB_MODE_AUTO
        default 1 if APP_CAMERA_WB_MODE_SUNNY
        default 2 if APP_CAMERA_WB_MODE_CLOUDY
        default 3 if APP_CAMERA_WB_MODE_OFFICE
        default 4 if APP_CAMERA_WB_MODE_HOME

endmenu
```

## sdkconfig.defaults
```kconfig
CONFIG_IDF_TARGET="esp32s3"

# PSRAM required for camera frame buffers
CONFIG_SPIRAM=y
CONFIG_SPIRAM_MODE_OCT=y
CONFIG_SPIRAM_SPEED_40M=y
CONFIG_SPIRAM_USE_MALLOC=y
CONFIG_SPIRAM_MALLOC_ALWAYSINTERNAL=16384
CONFIG_SPIRAM_MALLOC_RESERVE_INTERNAL=32768

# HTTPS uploads
CONFIG_MBEDTLS_CERTIFICATE_BUNDLE=y
CONFIG_MBEDTLS_CERTIFICATE_BUNDLE_DEFAULT_CMN=y
CONFIG_ESP_HTTP_CLIENT_ENABLE_HTTPS=y
```
